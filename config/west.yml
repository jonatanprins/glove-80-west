## config/west.yml
```yaml
manifest:
  defaults: 
      revision: v0.3.0 

  remotes:
    - name: urob
      url-base: https://github.com/urob
    - name: moergo-sc
      url-base: https://github.com/moergo-sc

  projects:
    # - name: zmk-adaptive-key
    #   remote: urob
    # - name: zmk-auto-layer
    #   remote: urob
    - name: zmk
      revision: v25.11
      remote: moergo-sc
      import: app/west.yml

  self:
    path: config
```
